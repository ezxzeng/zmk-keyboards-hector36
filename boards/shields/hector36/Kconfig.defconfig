## boards/shields/hector36/Kconfig.defconfig
```kconfig
if SHIELD_HECTOR36_LEFT

config ZMK_KEYBOARD_NAME
    default "HECTOR36"

config ZMK_SPLIT_ROLE_CENTRAL
    default y

endif

if SHIELD_HECTOR36_LEFT || SHIELD_HECTOR36_RIGHT
config ZMK_SPLIT
    default y
endif
```

## boards/shields/hector36/Kconfig.shield
```kconfig
# Copyright (c) 2022 The ZMK Contributors
# SPDX-License-Identifier: MIT

config SHIELD_HECTOR36_DONGLE
    def_bool $(shields_list_contains,hector36_dongle)

config SHIELD_HECTOR36_LEFT
    def_bool $(shields_list_contains,hector36_left)

config SHIELD_HECTOR36_RIGHT
    def_bool $(shields_list_contains,hector36_right)
```

## config/west.yml
```yaml
manifest:
  remotes:
    - name: zmkfirmware
      url-base: https://github.com/zmkfirmware
    - name: ezxzeng
      url-base: https://github.com/ezxzeng

  projects:
    - name: zmk
      remote: zmkfirmware
      revision: main
      import: app/west.yml

    #
    # Additional zmk modules
    #
    - name: zmk-keyboards-hector36
      remote: ezxzeng
      revision: main

  self:
    path: config
```
